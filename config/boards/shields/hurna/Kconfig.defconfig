## config/boards/shields/hurna/Kconfig.defconfig
```kconfig
if SHIELD_HURNA_DONGLE

config ZMK_KEYBOARD_NAME
    default "Hurna"

config ZMK_SPLIT_ROLE_CENTRAL
    default y

config ZMK_SPLIT_BLE_CENTRAL_PERIPHERALS
    default 2

endif

config ZMK_SPLIT
    default y
```

## config/boards/shields/hurna/Kconfig.shield
```kconfig
config SHIELD_HURNA_LEFT
    def_bool $(shields_list_contains,hurna_left)

config SHIELD_HURNA_RIGHT
    def_bool $(shields_list_contains,hurna_right)

config SHIELD_HURNA_DONGLE
    def_bool $(shields_list_contains,hurna_dongle)
```

## config/west.yml
```yaml
manifest:
  remotes:
    - name: zmkfirmware
      url-base: https://github.com/zmkfirmware
    - name: nrfconnect
      url-base: https://github.com/nrfconnect

  projects:
    - name: zmk
      remote: zmkfirmware
      revision: main
      import: app/west.yml
    - name: zmk_split_esb
      remote: zmkfirmware
      revision: main
      path: modules/zmk_split_esb
    - name: sdk-nrf
      remote: nrfconnect
      revision: v2.5-branch
      import:
        name-allowlist:
          - nrf
      path: nrf
    - name: sdk-nrfxlib
      remote: nrfconnect
      revision: v2.5-branch
      path: nrfxlib

  self:
    path: config
```
