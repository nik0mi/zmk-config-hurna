#include "hurna.dtsi"

&default_transform {
    col-offset = <6>;  
};

&kscan0 {
    row-gpios = <&pro_micro 21 GPIO_ACTIVE_HIGH>,
                <&pro_micro 3 GPIO_ACTIVE_HIGH>,
                <&pro_micro 15 GPIO_ACTIVE_HIGH>,
                <&pro_micro 16 GPIO_ACTIVE_HIGH>;
};
